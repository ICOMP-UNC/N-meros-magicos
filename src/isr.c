/*
 * filename.c
 *
 *  Created on: Jun 14, 2024
 *      Author: Horacio
 */

/********************************************************************
 *                      INCLUSIONES
 ********************************************************************/
#include "motor_ctrl.h"
#include "port.h"
#include <libopencm3/stm32/exti.h>

/********************************************************************
 *                      DEFINICIONES
 ********************************************************************/

/********************************************************************
 *                      ENUMERADOS
 ********************************************************************/

/********************************************************************
 *                      STRUCTS
 ********************************************************************/

/********************************************************************
 *                      VARIABLES LOCALES
 ********************************************************************/

/********************************************************************
 *                      PROTOTIPO FUNCIONES LOCALES
 ********************************************************************/

/********************************************************************
 *                      FUNCIONES LOCALES
 ********************************************************************/
static void retardo(void)
{
    for (int i = 0; i < 1000000; i++)
    {
    }
}
/********************************************************************
 *                      FUNCIONES GLOBALES
 ********************************************************************/

/**
 * @brief Handler de interrupciones externas
 *
 */
void exti9_5_isr()
{
    if (exti_get_flag_status(EXTI5))
    {
        exti_reset_request(EXTI5);
        retardo();
        MOTOR_CTRL_switch_1();
    }
    if (exti_get_flag_status(EXTI6))
    {
        exti_reset_request(EXTI6);
        retardo();
        MOTOR_CTRL_switch_2();
    }
    if (exti_get_flag_status(EXTI8))
    {
        exti_reset_request(EXTI8);
        retardo();
        MOTOR_CTRL_switch_3();
    }
}